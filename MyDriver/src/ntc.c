#include "ntc.h"
#include "adc.h"

/*****************************NTC阻值表****************************************/
static const int r_ntc[111] = 
{
179266,
168405,
158272,
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1284,
1243
};

int test_tab(void)
{
    int i;
    int r;
    unsigned int AD;
    double k, b/*,c*/;
    double temp;
    AD = Get_Adc();
    // r = (3.3 * AD * 10000 / 4096) / (2.99 - (3.3 * AD / 4096));
    r = (AD * 10000.0) / (4096 - AD); //计算公式修改 
    for(i = 0; i < 111; i++)
    {
        if(r >= r_ntc[i])
        {
            k = 1 / ((double)(r_ntc[i] - r_ntc[i - 1]));
            b = (i - 30) - r_ntc[i] * k;
            temp = (k * r + b) * 100;
            //			printf("k=%g   ,b=%f     temp=%f     c=%f\r\n",k,b,temp,c);
            break;
        }
        else
        {
            if(r >= 179266) temp = -3000;
            if(r <= 1243)  temp = 8000;
        }
    }
    //		printf("AD=%d      电压值：%0.3f       电阻值：%d       \r\n",AD,AD*3.3/4096,r);
    return temp;
}
